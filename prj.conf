## CMakeLists.txt
```
# SPDX-License-Identifier: Apache-2.0

cmake_minimum_required(VERSION 3.20.0)

find_package(Zephyr REQUIRED HINTS $ENV{ZEPHYR_BASE})
project(SecZeph)

target_sources(app PRIVATE src/main.c)
```

## west.yml
```
manifest:
  version: 0.7

  defaults:
    remote: zephyrproject

  remotes:
    - name: zephyrproject
      url-base: https://github.com/zephyrproject-rtos

  projects:
    - name: zephyr
      repo-path: zephyr
      revision: v4.2.0
      path: zephyr
      import:
        path-prefix: deps
        name-allowlist:
          - cmsis_6
          - hal_stm32
          - hal_espressif

  self:
    path: app
```

## prj.conf
```kconfig
# Shell
CONFIG_KERNEL_SHELL=y
CONFIG_SHELL=y
```

## boards/native_sim.conf
```kconfig
# Route UART0 I/O to host stdin/stdout for native_sim shell access
CONFIG_UART_NATIVE_PTY_0_ON_STDINOUT=y
```

## src/main.c
```c
#include <zephyr/kernel.h>

int main(void)
{
  printk("Hello World from the \"%s\" board\r\n", CONFIG_BOARD);

  return 0;
}
```
